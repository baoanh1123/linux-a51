## Documentation/devicetree/bindings/clock/samsung,exynos9610-clock.yaml
```yaml
# SPDX-License-Identifier: (GPL-2.0-only OR BSD-2-Clause)
%YAML 1.2
---
$id: http://devicetree.org/schemas/clock/samsung,exynos9610-clock.yaml#
$schema: http://devicetree.org/meta-schemas/core.yaml#

title: Samsung Exynos9610/Exynos9611 Clock Management Units

maintainers:
  - Krzysztof Kozlowski <krzk@kernel.org>
  - Sylwester Nawrocki <s.nawrocki@samsung.com>
  - Chanwoo Choi <cw00.choi@samsung.com>
  - Alim Akhtar <alim.akhtar@samsung.com>

description: |
  The initial Linux support describes the TOP, PERI, CORE, APM, and FSYS CMUs separately.
  The Shared PLLs, bus muxes, and dividers are read-only so the boot firmware's
  clock configuration is preserved. The TOP PERI bus gate preserves the
  hardware's manual or automatic gating mode while applying clock enable
  requests. PERI I2C, SPI, USI, USI I2C, and UART clocks use source-verified
  rate, divider, and peripheral gate paths. PCLK gates for GPIO_PERI,
  SYSREG_PERI, both WDT clusters, MCT, the bus-interface TMU, OTP controller,
  PWM motor, I2C controllers 0 through 6, and camera I2C controllers 0 through
  3 PCLKs are exposed for registration and rate reporting. The camera I2C
  functional clocks also use the vendor-defined PERI I2C divider. These gates
  preserve the hardware's manual or automatic gating mode. PERI I2C, SPI, USI,
  and UART reset-synchronizer clocks are also exposed with their CAL-defined
  functional-clock parents. PERI bus reset-sync, AXI2AHB, LHM AXI master, and
  CMU PCLK gates are exposed for rate reporting with the bus-user parent. I2C
  controller QCH clocks 0 through 6 are pass-through clocks matching the
  vendor virtual-clock behavior. TOP CMU CIS clock outputs 0 through 3 are
  exposed with read-only mux/divider settings and mode-aware gates. The TOP
  MMC PLL rate is decoded from its fractional register layout without
  changing it. The TOP CORE bus chain and CORE bus-user mux, divider, and CMU
  PCLK gate are exposed without changing firmware-selected clock settings.
  The APM bus path includes the live DLL DCO rate from its CAL-defined N_DCO
  register, plus the APM bus and PCLK gates; all muxes and dividers are
  read-only. The CMGP bus gate is sourced by the APM bus divider; CMGP CMU,
  SYSREG, and GPIO PCLK gates preserve the hardware's manual or automatic
  gating mode. FSYS exposes the source-mapped MMC-card ACLK and SDCLKIN gates,
  plus the QCH request clock using the CAL enable/request bit behavior.

properties:
  compatible:
    enum:
      - samsung,exynos9610-cmu-top
      - samsung,exynos9610-cmu-peri
      - samsung,exynos9610-cmu-core
      - samsung,exynos9610-cmu-apm
      - samsung,exynos9610-cmu-cmgp
      - samsung,exynos9610-cmu-fsys

  reg:
    minItems: 1
    maxItems: 2

  reg-names:
    minItems: 1
    maxItems: 2

  "#clock-cells":
    const: 1

  clocks:
    minItems: 1
    maxItems: 3

  clock-names:
    minItems: 1
    maxItems: 3

required:
  - compatible
  - reg
  - "#clock-cells"
  - clocks
  - clock-names

allOf:
  - if:
      properties:
        compatible:
          const: samsung,exynos9610-cmu-top
    then:
      properties:
        reg:
          maxItems: 1
        clocks:
          maxItems: 1
        clock-names:
          items:
            - const: fin_pll
  - if:
      properties:
        compatible:
          const: samsung,exynos9610-cmu-peri
    then:
      properties:
        reg:
          maxItems: 1
        clocks:
          minItems: 2
        clock-names:
          items:
            - const: fin_pll
            - const: dout_peri_bus
  - if:
      properties:
        compatible:
          const: samsung,exynos9610-cmu-core
    then:
      properties:
        reg:
          maxItems: 1
        clocks:
          minItems: 2
          maxItems: 2
        clock-names:
          items:
            - const: fin_pll
            - const: dout_core_bus
  - if:
      properties:
        compatible:
          const: samsung,exynos9610-cmu-apm
    then:
      properties:
        reg:
          maxItems: 2
        reg-names:
          items:
            - const: cmu
            - const: dll
        clocks:
          minItems: 2
          maxItems: 2
        clock-names:
          items:
            - const: oscclk_rco_apm
            - const: dout_apm_bus
      required:
        - reg-names
  - if:
      properties:
        compatible:
          const: samsung,exynos9610-cmu-cmgp
    then:
      properties:
        reg:
          maxItems: 1
        clocks:
          maxItems: 1
        clock-names:
          items:
            - const: clkcmu_cmgp_bus
  - if:
      properties:
        compatible:
          const: samsung,exynos9610-cmu-fsys
    then:
      properties:
        reg:
          maxItems: 1
        clocks:
          minItems: 3
          maxItems: 3
        clock-names:
          items:
            - const: oscclk_fsys
            - const: dout_fsys_bus
            - const: dout_fsys_mmc_card

additionalProperties: false

examples:
  - |
    / {
        #address-cells = <1>;
        #size-cells = <1>;

        oscclk: oscillator {
            compatible = "fixed-clock";
            #clock-cells = <0>;
            clock-frequency = <26000000>;
        };

        clock-controller@12100000 {
            compatible = "samsung,exynos9610-cmu-top";
            reg = <0x12100000 0x8000>;
            #clock-cells = <1>;
            clocks = <&oscclk>;
            clock-names = "fin_pll";
        };
    };
```

## Documentation/devicetree/bindings/power/supply/siliconmitus,sm5713-fuelgauge.yaml
```yaml
# SPDX-License-Identifier: (GPL-2.0-only OR BSD-2-Clause)
%YAML 1.2
---
$id: http://devicetree.org/schemas/power/supply/siliconmitus,sm5713-fuelgauge.yaml#
$schema: http://devicetree.org/meta-schemas/core.yaml#

title: Silicon Mitus SM5713 fuel gauge

maintainers:
  - Bao Anh <baoanh@example.com>

description: |
  The SM5713 is a companion chip found on Samsung Exynos9610/9611 boards that
  combines a switch-mode charger, a fuel gauge and a MUIC.  The fuel gauge has
  its own I2C address and reports battery capacity, voltage, current and
  temperature.

properties:
  compatible:
    const: siliconmitus,sm5713-fuelgauge

  reg:
    maxItems: 1

required:
  - compatible
  - reg

additionalProperties: false

examples:
  - |
    i2c {
        #address-cells = <1>;
        #size-cells = <0>;

        fuel-gauge@71 {
            compatible = "siliconmitus,sm5713-fuelgauge";
            reg = <0x71>;
        };
    };
```

## Documentation/devicetree/bindings/soc/samsung/exynos-wlbt.yaml
```yaml
# SPDX-License-Identifier: (GPL-2.0-only OR BSD-2-Clause)
%YAML 1.2
---
$id: http://devicetree.org/schemas/soc/samsung/exynos-wlbt.yaml#
$schema: http://devicetree.org/meta-schemas/core.yaml#

title: Samsung Exynos SCSC/WLBT wireless subsystem

description:
  The SCSC block carries the WiFi and Bluetooth combo chip (called mx140 in
  Samsung's driver) on several Exynos SoCs.  It is not an ordinary peripheral:
  it has its own firmware, its own power domain and a mailbox interface, and the
  AP has to expose DRAM and a few peripheral ranges to it through bus window
  controllers before it can boot.  This node describes the mailbox and the
  window controllers that belong to it.

maintainers:
  - Samsung Exynos mainline port <noreply@example.com>

properties:
  compatible:
    const: samsung,scsc_wifibt

  reg:
    maxItems: 1

  interrupts:
    items:
      - description: mailbox doorbell from the subsystem
      - description: subsystem alive indication
      - description: subsystem watchdog reset request
      - description: subsystem boot configuration request

  interrupt-names:
    items:
      - const: MBOX
      - const: ALIVE
      - const: WDOG
      - const: CFG_REQ

  memory-region:
    maxItems: 1
    description:
      MIF DRAM window.  The subsystem boots its firmware from this memory and
      sees it through the data bus window, so it must be at least 16 MiB.

  samsung,syscon-phandle:
    $ref: /schemas/types.yaml#/definitions/phandle
    description: PMU registers holding the power and reset control.

  samsung,dbus_baaw-syscon-phandle:
    $ref: /schemas/types.yaml#/definitions/phandle
    description: Data bus window controller that maps the MIF DRAM.

  samsung,pbus_baaw-syscon-phandle:
    $ref: /schemas/types.yaml#/definitions/phandle
    description: Peripheral bus window controller.

  samsung,wlbt_remap-syscon-phandle:
    $ref: /schemas/types.yaml#/definitions/phandle
    description: Address remap block used during the boot handshake.

  samsung,boot_cfg-syscon-phandle:
    $ref: /schemas/types.yaml#/definitions/phandle
    description: Boot configuration window used during the boot handshake.

required:
  - compatible
  - reg
  - interrupts
  - interrupt-names
  - memory-region
  - samsung,syscon-phandle

additionalProperties: false

examples:
  - |
    wifibt@119c0000 {
        compatible = "samsung,scsc_wifibt";
        reg = <0x119c0000 0x180>;
        interrupts = <0 42 4>, <0 28 4>, <0 72 4>, <0 73 4>;
        interrupt-names = "MBOX", "ALIVE", "WDOG", "CFG_REQ";
        memory-region = <&wifibt_mem>;
        samsung,syscon-phandle = <&pmu_system_controller>;
        samsung,dbus_baaw-syscon-phandle = <&dbus_baaw>;
        samsung,pbus_baaw-syscon-phandle = <&pbus_baaw>;
        samsung,wlbt_remap-syscon-phandle = <&wlbt_remap>;
        samsung,boot_cfg-syscon-phandle = <&boot_cfg>;
    };
```

## Documentation/devicetree/bindings/soc/samsung/exynos9611-mshc-snapshot.yaml
```yaml
# SPDX-License-Identifier: (GPL-2.0-only OR BSD-2-Clause)
%YAML 1.2
---
$id: http://devicetree.org/schemas/soc/samsung/exynos9611-mshc-snapshot.yaml#
$schema: http://devicetree.org/meta-schemas/core.yaml#

title: Samsung Exynos9611 MSHC read-only snapshot diagnostic

maintainers:
  - Alim Akhtar <alim.akhtar@samsung.com>

description: |
  Test-only platform device for reading a bounded set of Exynos9611 MSHC
  identification and clock-state registers during bring-up. The driver
  temporarily enables the bus and QCH clocks, performs read-only register
  accesses, then disables the clocks. It does not enable SDCLKIN, reset the
  block, or issue MMC/SD commands.

properties:
  compatible:
    const: samsung,exynos9611-mshc-snapshot

  reg:
    maxItems: 1

  clocks:
    items:
      - description: MSHC bus interface clock
      - description: MSHC Q-channel clock

  clock-names:
    items:
      - const: aclk
      - const: qch

required:
  - compatible
  - reg
  - clocks
  - clock-names

additionalProperties: false

examples:
  - |
    #include <dt-bindings/clock/samsung,exynos9610-cmu.h>

    / {
        #address-cells = <2>;
        #size-cells = <1>;

        snapshot@13550000 {
            compatible = "samsung,exynos9611-mshc-snapshot";
            reg = <0x0 0x13550000 0x2000>;
            clocks = <&fsys 3>, <&fsys 5>;
            clock-names = "aclk", "qch";
        };
    };
```

## arch/arm64/configs/exynos9611_a51_defconfig
```kconfig
CONFIG_ARCH_EXYNOS=y
CONFIG_BLK_DEV_INITRD=y
CONFIG_RD_GZIP=y
CONFIG_DEVTMPFS=y
CONFIG_MMC=y
CONFIG_MMC_DW=y
CONFIG_MMC_DW_EXYNOS=y
CONFIG_MMC_BLOCK=y
CONFIG_EXT4_FS=y
CONFIG_EXFAT_FS=y
CONFIG_NLS_UTF8=y
CONFIG_REGULATOR=y
CONFIG_REGULATOR_FIXED_VOLTAGE=y
CONFIG_REGULATOR_S2MPU09=y
CONFIG_INPUT=y
CONFIG_INPUT_EVDEV=y
CONFIG_KEYBOARD_GPIO=y
CONFIG_DEBUG_FS=y
CONFIG_MAILBOX=y
CONFIG_EXYNOS_MBOX=y
CONFIG_EXYNOS_ACPM_PROTOCOL=y
CONFIG_PSTORE=y
CONFIG_PSTORE_RAM=y
# CONFIG_PSTORE_COMPRESS is not set
CONFIG_PSTORE_CONSOLE=y
CONFIG_PSTORE_PMSG=y
CONFIG_PSTORE_FTRACE=y
CONFIG_FTRACE=y
CONFIG_FUNCTION_TRACER=y
CONFIG_PRINTK_TIME=y
CONFIG_I2C=y
CONFIG_I2C_CHARDEV=y
CONFIG_I2C_S3C2410=y
CONFIG_I2C_EXYNOS_SPEEDY=y
CONFIG_CONFIGFS_FS=y
CONFIG_USB_GADGET=y
CONFIG_USB_DWC3=y
CONFIG_USB_DWC3_GADGET=y
CONFIG_USB_CONFIGFS=y
CONFIG_USB_CONFIGFS_ACM=y
CONFIG_USB_CONFIGFS_ECM=y
CONFIG_NET=y
CONFIG_PACKET=y
CONFIG_UNIX=y
CONFIG_INET=y
CONFIG_NETDEVICES=y
CONFIG_CMA=y
CONFIG_DMA_CMA=y
CONFIG_DRM=y
# CONFIG_DRM_SIMPLEDRM is not set
CONFIG_DRM_EXYNOS9610=y
# The DPU sits behind sysmmu@14820000; without it PRIME imports bounce
# through SWIOTLB (notes/gpu.md).
CONFIG_EXYNOS_IOMMU=y
CONFIG_MODULES=y
CONFIG_MODULE_UNLOAD=y
CONFIG_EXYNOS9610_G3D_PD=y
CONFIG_DRM_EXYNOS9610_DSIM=y
CONFIG_DRM_FBDEV_EMULATION=y
CONFIG_FB=y
CONFIG_FRAMEBUFFER_CONSOLE=y
CONFIG_USB_DWC3_EXYNOS=y
CONFIG_PHY_EXYNOS5_USBDRD=y
CONFIG_SCSI=y
CONFIG_BLK_DEV_SD=y
CONFIG_SCSI_UFSHCD=y
CONFIG_SCSI_UFSHCD_PLATFORM=y
CONFIG_SCSI_UFS_EXYNOS=y
CONFIG_PHY_SAMSUNG_UFS=y
CONFIG_TMPFS=y
CONFIG_TMPFS_POSIX_ACL=y
CONFIG_TMPFS_XATTR=y
CONFIG_POWER_RESET_SYSCON=y
CONFIG_POWER_RESET_SYSCON_POWEROFF=y
CONFIG_MAGIC_SYSRQ=y
CONFIG_MAGIC_SYSRQ_DEFAULT_ENABLE=0x1
CONFIG_RTC_CLASS=y
CONFIG_RTC_HCTOSYS=y
CONFIG_PM_DEBUG=y
CONFIG_PM_SLEEP_DEBUG=y
CONFIG_PM_TEST_SUSPEND=y
CONFIG_RTC_DRV_S3C=y
CONFIG_WATCHDOG=y
CONFIG_WATCHDOG_CORE=y
CONFIG_S3C2410_WATCHDOG=y
CONFIG_CGROUPS=y
CONFIG_CGROUP_FREEZER=y
CONFIG_CGROUP_PIDS=y
CONFIG_CGROUP_DEVICE=y
CONFIG_CGROUP_CPUACCT=y
CONFIG_CPUSETS=y
CONFIG_MEMCG=y
CONFIG_PSI=y
CONFIG_KEYS=y
CONFIG_FANOTIFY=y
CONFIG_DEVTMPFS_MOUNT=y
CONFIG_AUDIT=y
CONFIG_AUDITSYSCALL=y
CONFIG_BLK_DEV_LOOP=y
CONFIG_OVERLAY_FS=y
CONFIG_BRIDGE=y
CONFIG_VETH=y
CONFIG_TUN=y
CONFIG_NETFILTER=y
CONFIG_NF_TABLES=y
CONFIG_NETFILTER_XTABLES=y
CONFIG_IP_NF_IPTABLES=y
CONFIG_IP_NF_FILTER=y
CONFIG_IP_NF_NAT=y
CONFIG_PERF_EVENTS=y
CONFIG_BPF_SYSCALL=y
CONFIG_CGROUP_SCHED=y
CONFIG_FAIR_GROUP_SCHED=y
CONFIG_CFS_BANDWIDTH=y
CONFIG_BLK_CGROUP=y
CONFIG_CGROUP_BPF=y
CONFIG_AUTOFS_FS=y
CONFIG_POWER_SUPPLY=y
CONFIG_BATTERY_SM5713=y
CONFIG_CHARGER_SM5713=y
CONFIG_MUIC_SM5713=y
CONFIG_ARM_EXYNOS_ACPM_DVFS=y
CONFIG_CPU_FREQ=y

CONFIG_THERMAL=y
CONFIG_THERMAL_OF=y
CONFIG_EXYNOS9610_TMU=y
CONFIG_EXYNOS9610_CPUHP=y
CONFIG_POWER_RESET_EXYNOS9610=y
CONFIG_TOUCHSCREEN_MSS100=y
CONFIG_INPUT_TOUCHSCREEN=y
CONFIG_TOUCHSCREEN_MSS100=y
CONFIG_DRM_PANEL_SAMSUNG_EA8076=y
CONFIG_DRM_PANFROST=y
CONFIG_DRM_MIPI_DSI=y
CONFIG_DRM_PANEL=y
CONFIG_BACKLIGHT_CLASS_DEVICE=y

# Root filesystem over NFS (the microSD host path is slow on this board)
CONFIG_NFS_FS=y
CONFIG_NFS_V4=y
CONFIG_NFS_V4_1=y
CONFIG_NFS_V4_2=y
```

## drivers/gpu/drm/exynos9610/Kconfig
```kconfig
# SPDX-License-Identifier: GPL-2.0-only
config DRM_EXYNOS9610
	tristate "DRM Support for Samsung Exynos 9610/9611 DPU 2.0"
	depends on DRM && OF && ARM64
	select DRM_CLIENT_SELECTION
	select DRM_GEM_DMA_HELPER
	select DRM_KMS_HELPER
	select VIDEOMODE_HELPERS
	help
	  DRM/KMS driver for the display processing unit (DPU 2.0,
	  "exynos9-decon") found in the Samsung Exynos 9610/9611 SoCs.

	  The driver takes over the display pipeline that the Samsung boot
	  chain already initialised through uniLoader: DECON and its IDMA
	  channel are reprogrammed to scan out a kernel framebuffer while
	  DSIM and the panel keep running untouched.

	  If M is selected the module will be called exynos9610_dpu.

config DRM_EXYNOS9610_DSIM
	tristate "Samsung Exynos 9610/9611 DSIM (MIPI DSI master) support"
	depends on OF && ARM64 && DRM_EXYNOS9610
	default DRM_EXYNOS9610
	select DRM_MIPI_DSI
	help
	  MIPI DSIM (DSI master) support for the Samsung Exynos 9610/9611
	  SoCs, in handoff mode: the Samsung boot loader initialises the link
	  and the D-PHY, and this driver keeps that configuration while
	  providing a MIPI DSI host for the panel driver, plus DCS read/write
	  and link debug helpers.

	  If M is selected the module will be called exynos9610_dsim.
```

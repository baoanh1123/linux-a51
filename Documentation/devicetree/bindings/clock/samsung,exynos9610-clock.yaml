## drivers/soc/samsung/Kconfig
```kconfig
# SPDX-License-Identifier: GPL-2.0
#
# Samsung SoC drivers
#
menuconfig SOC_SAMSUNG
	bool "Samsung SoC driver support" if COMPILE_TEST

if SOC_SAMSUNG

# There is no need to enable these drivers for ARMv8
config EXYNOS_ASV_ARM
	bool "Exynos ASV ARMv7-specific driver extensions" if COMPILE_TEST
	depends on EXYNOS_CHIPID

config EXYNOS_CHIPID
	tristate "Exynos ChipID controller and ASV driver"
	depends on ARCH_EXYNOS || COMPILE_TEST
	default ARCH_EXYNOS
	select EXYNOS_ASV_ARM if ARM && ARCH_EXYNOS
	select MFD_SYSCON
	select SOC_BUS
	help
	  Support for Samsung Exynos SoC ChipID and Adaptive Supply Voltage.
	  This driver can also be built as module (exynos_chipid).

config EXYNOS_USI
	tristate "Exynos USI (Universal Serial Interface) driver"
	default ARCH_EXYNOS && ARM64
	depends on ARCH_EXYNOS || COMPILE_TEST
	select MFD_SYSCON
	help
	  Enable support for USI block. USI (Universal Serial Interface) is an
	  IP-core found in modern Samsung Exynos SoCs, like Exynos850 and
	  ExynosAutoV9. USI block can be configured to provide one of the
	  following serial protocols: UART, SPI or High Speed I2C.

	  This driver allows one to configure USI for desired protocol, which
	  is usually done in USI node in Device Tree.

config EXYNOS_PMU
	bool "Exynos PMU controller driver" if COMPILE_TEST
	depends on ARCH_EXYNOS || ((ARM || ARM64) && COMPILE_TEST)
	select EXYNOS_PMU_ARM_DRIVERS if ARM && ARCH_EXYNOS
	select MFD_CORE
	select REGMAP_MMIO

# There is no need to enable these drivers for ARMv8
config EXYNOS_PMU_ARM_DRIVERS
	bool "Exynos PMU ARMv7-specific driver extensions" if COMPILE_TEST
	depends on EXYNOS_PMU

config SAMSUNG_PM_CHECK
	bool "S3C2410 PM Suspend Memory CRC"
	depends on PM && (ARCH_S3C64XX || ARCH_S5PV210)
	select CRC32
	help
	  Enable the PM code's memory area checksum over sleep. This option
	  will generate CRCs of all blocks of memory, and store them before
	  going to sleep. The blocks are then checked on resume for any
	  errors.

	  Note, this can take several seconds depending on memory size
	  and CPU speed.

config SAMSUNG_PM_CHECK_CHUNKSIZE
	int "S3C2410 PM Suspend CRC Chunksize (KiB)"
	depends on PM && SAMSUNG_PM_CHECK
	default 64
	help
	  Set the chunksize in Kilobytes of the CRC for checking memory
	  corruption over suspend and resume. A smaller value will mean that
	  the CRC data block will take more memory, but will identify any
	  faults with better precision.

config EXYNOS_REGULATOR_COUPLER
	bool "Exynos SoC Regulator Coupler" if COMPILE_TEST
	depends on ARCH_EXYNOS || COMPILE_TEST

config EXYNOS9611_MSHC_SNAPSHOT
	bool "Exynos9611 MSHC read-only snapshot diagnostic"
	depends on ARCH_EXYNOS && COMMON_CLK && OF
	help
	  Enable a test-only, read-only register snapshot endpoint for the
	  Exynos9611 MSHC. It enables the controller's bus clocks briefly,
	  reads identification and clock-state registers, and exposes the
	  captured values through a read-only misc device. It does not reset
	  the controller or issue MMC/SD commands.
endif

config EXYNOS9610_CPUHP
	bool "Exynos 9610/9611 CPU hotplug power sequencing"
	depends on ARCH_EXYNOS || COMPILE_TEST
	help
	  Program the CPUCFG power gates around CPU hotplug on Samsung
	  Exynos 9610/9611 SoCs.  The PSCI implementation of the bootloader
	  cannot power a core back up after CPU_OFF, so the power gate has to
	  be handled by Linux before PSCI is asked to start the core.

config EXYNOS9610_G3D_PD
	tristate "Exynos 9610 G3D power-domain experiment"
	depends on ARCH_EXYNOS || COMPILE_TEST
	help
	  Experimental driver for the Mali-G72 power domain (PMU + 0x4060).
	  It exposes debugfs knobs to power the domain down and back up with the
	  vendor register sequences, so the sequence can be validated by hand
	  before any device is attached to the domain.

config EXYNOS9610_WLBT
	tristate "Exynos 9610 SCSC/WLBT Wi-Fi and Bluetooth transport"
	depends on ARCH_EXYNOS || COMPILE_TEST
	depends on ARM64
	depends on EXYNOS9610_ABOX
	help
	  Power up the Samsung SCSC ("mx140") WiFi/Bluetooth subsystem, load
	  its firmware and drive its Wi-Fi transport over the HIP4 queues: a
	  station interface on 2.4 and 5 GHz with WPA2 and WPA3, registered
	  with cfg80211.

	  When CONFIG_BT is enabled the same driver also starts the peer Bluetooth
	  service over the shared service-management channel, lays out the BHCS
	  and BSMHCP shared memory, and registers an HCI device driven through
	  the Bluetooth core.

	  The Galaxy A51 has no SDIO and no PCIe WiFi, so this block is the
	  only route to a built-in wireless interface.  Say M unless you are
	  working on that port.

config EXYNOS9610_DISPAUD_PD
	bool "Exynos 9610 DISPAUD power domain"
	depends on ARCH_EXYNOS || COMPILE_TEST
	help
	  Power up the audio DSP power domain at boot.  CMU_DISPAUD, the ABOX
	  registers and the ABOX SRAM are unreachable while the domain is off.

config EXYNOS9610_ABOX
	tristate "Exynos 9610 ABOX bring-up"
	depends on ARCH_EXYNOS || COMPILE_TEST
	help
	  Program the audio PLL and bus clocks and probe the ABOX DSP block.
	  This is a bring-up driver, not a sound card yet.
```

## drivers/thermal/samsung/Kconfig
```kconfig
# SPDX-License-Identifier: GPL-2.0-only
config EXYNOS_THERMAL
	tristate "Exynos thermal management unit driver"
	depends on THERMAL_OF
	depends on HAS_IOMEM
	help
	  If you say yes here you get support for the TMU (Thermal Management
	  Unit) driver for Samsung Exynos series of SoCs. This driver initialises
	  the TMU, reports temperature and handles cooling action if defined.
	  This driver uses the Exynos core thermal APIs and TMU configuration
	  data from the supported SoCs.

config EXYNOS9610_TMU
	tristate "Samsung Exynos 9610/9611 TMU driver"
	depends on THERMAL_OF
	depends on HAS_IOMEM
	help
	  Support for the multi channel TMU block found on the Samsung
	  Exynos 9610 and 9611 SoCs.  One thermal zone is registered per
	  channel (BIG, LITTLE, G3D, ISP) and reports the hottest of its
	  sensing points.
```
